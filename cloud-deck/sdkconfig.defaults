## cloud-deck/sdkconfig.defaults
```kconfig
CONFIG_ESPTOOLPY_HEADER_FLASHSIZE_UPDATE=y

CONFIG_ESP_CONSOLE_USB_SERIAL_JTAG=y
CONFIG_ESP_CONSOLE_SECONDARY_NONE=y

CONFIG_SPIRAM=y
CONFIG_SPIRAM_MODE_OCT=y
CONFIG_SPIRAM_SPEED_80M=y

CONFIG_HTTPD_WS_SUPPORT=y

CONFIG_LOG_DEFAULT_LEVEL_DEBUG=y
CONFIG_HTTPD_LOG_LEVEL_DEBUG=y

CONFIG_CAMERA_TASK_STACK_SIZE=8192

CONFIG_ESP_WIFI_STATIC_RX_BUFFER_NUM=6
CONFIG_ESP_WIFI_DYNAMIC_RX_BUFFER_NUM=16
CONFIG_ESP_WIFI_DYNAMIC_TX_BUFFER_NUM=28
CONFIG_ESP_WIFI_RX_BA_WIN=6

CONFIG_LWIP_TCP_SND_BUF_DEFAULT=28672
CONFIG_LWIP_TCP_WND_DEFAULT=16384
```
